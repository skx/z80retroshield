
#include <z80retroshield.h>

//
// Our program.
//
unsigned char memory[1024] =
{
    0x31, 0xfb, 0x00, 0x3e, 0x3e, 0xd3, 0x01, 0x21, 0xfb, 0x00, 0x36, 0x0a,
    0xdb, 0x01, 0x77, 0xfe, 0x0a, 0x28, 0x03, 0x23, 0x18, 0xf4, 0xcd, 0xb3,
    0x00, 0x21, 0xfb, 0x00, 0x7e, 0x23, 0xfe, 0x43, 0x28, 0x18, 0xfe, 0x44,
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    0x00, 0x00, 0x00, 0x00, 0x00, 0x00, 0x00, 0x00, 0x00, 0x00, 0x00
};
int memory_len = sizeof(memory) / sizeof(memory[0]);

//
// Scratch area for format-strings.
//
char tmp[64] = { '\0' };

//
// Our helper
//
Z80RetroShield cpu;


//
// RAM I/O function handler.
//
char memory_read(int address)
{
    if (address >= 0 && address < memory_len)
        return (memory[address]) ;
    else
    {
        sprintf(tmp, "Attempted read out of bounds memory %04x", address);
        Serial.println(tmp);
        return 0;
    }
}

//
// RAM I/O function handler.
//
void memory_write(int address, char value)
{
    if (address >= 0 && address < memory_len)
        memory[address] = value;
    else
    {
        sprintf(tmp, "Attempted write to %04x - %02d", address, value);
        Serial.println(tmp);
    }
}


//
// I/O function handler.
//
char io_read(int address)
{
    if (address == 1)
    {
        char r;

        //
        // Ensure there is at least one character available.
        //
        while (! Serial.available())
        {
            delay(1);
        }

        //
        // Read and return the character.
        //
        r = Serial.read();
        return (r);
    }
    else
    {
        sprintf(tmp, "Attempted to read I/O port %d", address);
        Serial.println(tmp);
    }

    return 0;
}

//
// I/O function handler.
//
void io_write(int address, char byte)
{
    if (address == 1)
        Serial.write(byte);
    else
    {
        sprintf(tmp, "Attempted write to I/O port %02X with value %02X",
                address, byte);
        Serial.println(tmp);

    }
}


//
// Setup routine: Called once.
//
void setup()
{
    Serial.begin(115200);


    //
    // Setup callbacks for memory read/writes.
    //
    cpu.set_ram_read(memory_read);
    cpu.set_ram_write(memory_write);

    //
    // Now setup a callback to be executed every time an IN/OUT
    // instruction is encountered.
    //
    cpu.set_io_read(io_read);
    cpu.set_io_write(io_write);

    //
    // Configured.
    //
    Serial.println("Z80 configured; launching program.");
}


//
// Loop function: Called forever.
//
void loop()
{
    //
    // Step the CPU.
    //
    cpu.Tick();
}
